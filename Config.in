## Config.in
```kconfig
source "$BR2_EXTERNAL_NET_ADSB_PATH/package/dump1090_mutability/Config.in"
source "$BR2_EXTERNAL_NET_ADSB_PATH/package/flightradar24/Config.in"
source "$BR2_EXTERNAL_NET_ADSB_PATH/package/tcllauncher/Config.in"
source "$BR2_EXTERNAL_NET_ADSB_PATH/package/flightaware/Config.in"
source "$BR2_EXTERNAL_NET_ADSB_PATH/package/multimon-ng/Config.in"
source "$BR2_EXTERNAL_NET_ADSB_PATH/package/lte-cell-scanner/Config.in"
```

## package/dump1090_mutability/Config.in
```kconfig
config BR2_PACKAGE_DUMP1090_MUTABILITY
	bool "dump1090_mutability"
	depends on BR2_TOOLCHAIN_HAS_THREADS # librtlsdr
	depends on !BR2_PACKAGE_TINYHTTPD # Does not parse CSS and JSON correctly
	select BR2_PACKAGE_LIBRTLSDR
	help
	  Dump1090 is a simple Mode S decoder for RTLSDR devices

	  https://github.com/MalcolmRobb/dump1090

	  This is the https://github.com/mutability/dump1090 fork of the above

comment "dump1090 needs a toolchain w/ threads"
	depends on !BR2_TOOLCHAIN_HAS_THREADS

comment "dump1090 will not work with TinyHTTPD"
	depends on BR2_PACKAGE_TINYHTTPD
```

## package/flightaware/Config.in
```kconfig
config BR2_PACKAGE_FLIGHTAWARE
	bool "Flight Aware (BROKEN)"
	depends on BR2_PACKAGE_DUMP1090
	select BR2_PACKAGE_TCL
	help
	    This will install the piaware tools to send data to flightaware

comment "Flight Aware required DUMP1090 (regular untested)
	depends on !BR2_PACKAGE_DUMP1090
```

## package/flightradar24/Config.in
```kconfig
config BR2_PACKAGE_FLIGHTRADAR24
	bool "Flight Radar 24"
	depends on BR2_PACKAGE_DUMP1090
	help
	    This will install the staticly linked ARM binaries

comment "Flight Aware required DUMP1090 (regular untested)
	depends on !BR2_PACKAGE_DUMP1090
```

## package/lte-cell-scanner/Config.in
```kconfig
config BR2_PACKAGE_LTE_CELL_SCANNER
	bool "LTE Cell Scanner (BROKEN)"
	depends on BR2_PACKAGE_LIBRTLSDR
	depends on BR2_TOOLCHAIN_BUILDROOT_CXX
	depends on BR2_PACKAGE_BOOST
	depends on BR2_PACKAGE_BOOST_SYSTEM
	depends on BR2_PACKAGE_BOOST_THREAD

	help
	  This is https://github.com/flightaware/tcllauncher

comment "LTE_CELL_SCANNER needs a toolchain w/ c++"
	depends on !BR2_TOOLCHAIN_BUILDROOT_CXX

comment "LTE_CELL_SCANNER requires BOOST with System and Threads"
	depends on !BR2_PACKAGE_BOOST
	depends on !BR2_PACKAGE_BOOST_SYSTEM
	depends on !BR2_PACKAGE_BOOST_THREAD
```

## package/multimon-ng/Config.in
```kconfig
config BR2_PACKAGE_MULTIMON_NG
	bool "Multimon-ng"
	select BR2_PACKAGE_LIBRTLSDR
	help
            multimon-ng is the successor of multimon. It decodes the following digital transmission
```

## package/tcllauncher/Config.in
```kconfig
config BR2_PACKAGE_TCLLAUNCHER
	bool "TCL Launcher (BROKEN)"
	help
	  This is https://github.com/flightaware/tcllauncher
```
